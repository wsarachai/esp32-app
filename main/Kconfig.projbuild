## main/Kconfig.projbuild
```kconfig
menu "Example Configuration"

    config MQTT_CLIENT_IDENTIFIER
        string "The MQTT client identifier used in this example"
        default "testClient"
        help
            The MQTT client identifier used in this example. Each client identifier must be unique.
            so edit as required to ensure that no two clients connecting to the same broker use the same client identifier.

    config MQTT_BROKER_ENDPOINT
        string "Endpoint of the MQTT broker to connect to"
        default "test.mosquitto.org"
        help
            This example can be run with any MQTT broker, that supports server authentication.

    config MQTT_BROKER_PORT
        int "Port of the MQTT broker use"
        default 8883
        help
            In general, port 8883 is for secured MQTT connections.
            Port 443 requires use of the ALPN TLS extension with the ALPN protocol name.
            When using port 8883, ALPN is not required.

    config HARDWARE_PLATFORM_NAME
        string "The hardware platform"
        default "ESP32"
        help
            The name of the hardware platform the application is running on.

    config MQTT_NETWORK_BUFFER_SIZE
        int "Size of the network buffer for MQTT packets"
        range 1024 2048
        default 1024
        help
            Size of the network buffer for MQTT packets.

    choice EXAMPLE_CHOOSE_PKI_ACCESS_METHOD
        prompt "Choose PKI credentials access method"
        default EXAMPLE_USE_PLAIN_FLASH_STORAGE
        help
            ESP devices support multiple ways to secure store the PKI credentials.
            Currently Secure Element (ATECC608A) and DS peripheral
            (using ESP Secure Cert Manager) are supported.
            The default behaviour is to access the PKI credentials which are embedded in the binary.
            Consult the ESP-TLS documentation in ESP-IDF Programming guide for more details.

        config EXAMPLE_USE_SECURE_ELEMENT
        bool "Use secure element (ATECC608A)"
        depends on (IDF_TARGET_ESP32 || IDF_TARGET_ESP32C2) && ESP_TLS_USING_MBEDTLS
        select ESP_TLS_USE_SECURE_ELEMENT
        help
            Enable the use of secure element for the example.
            The esp-cryptoauthlib component is required for enabling
            this option.

        config EXAMPLE_USE_ESP_SECURE_CERT_MGR
        bool "Use ESP Secure Certificate Manager"
        help
            Enable the use of ESP Secure Certificate Manager APIs for the example.
            Please refer to ESP Secure Certificate Manager documentation for more details.

        config EXAMPLE_USE_PLAIN_FLASH_STORAGE
        bool "Use flash storage (default)"
        help
            This option expects the Private key and Device certificate to be embedded in the binary.
            This is the default behaviour.
    endchoice

endmenu

menu "DS3231 Configuration"

    config SCL_GPIO
        int "DS3231 SCL GPIO number"
        range 0 34
        default 15
        help
            GPIO number (IOxx) to DS3231 SCL.
            Some GPIOs are used for other purposes (flash connections, etc.) and cannot be used to CS.
            GPIOs 35-39 are input-only so cannot be used as outputs.

    config SDA_GPIO
        int "DS3231 SDA GPIO number"
        range 0 34
        default 16
        help
            GPIO number (IOxx) to DS3231 SDA.
            Some GPIOs are used for other purposes (flash connections, etc.) and cannot be used to DC.
            GPIOs 35-39 are input-only so cannot be used as outputs.

    config TIMEZONE
        int "Your TimeZone"
        range -23 23
        default 0
        help
            Your local timezone.
            When it is 0, Greenwich Mean Time.

    choice MODE
        prompt "Access Mode"
        default SET_CLOCK
        help
            Select mode for the example.
        config SET_CLOCK
            bool "Set Clock & Get Clock"
            help
                Set clock to DS3213 & Get clock from DS3213.
        config GET_CLOCK
            bool "Only Get Clock"
            help
                Get clock from DS3213.
        config DIFF_CLOCK
            bool "Get the time difference"
            help
                Get the time difference of NTP and RTC.
    endchoice

if SET_CLOCK || DIFF_CLOCK
    config NTP_SERVER
        string "NTP Server"
        default "pool.ntp.org"
        help
            Hostname for NTP Server.
endif

endmenu
```
